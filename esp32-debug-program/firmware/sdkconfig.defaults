## esp32-debug-program/firmware/sdkconfig.defaults
```kconfig
CONFIG_IDF_TARGET="esp32p4"

# Waveshare ESP32-P4-WIFI6-POE-ETH
CONFIG_ESPTOOLPY_FLASHMODE_QIO=y
CONFIG_ESPTOOLPY_FLASHFREQ_80M=y
CONFIG_ESPTOOLPY_FLASHSIZE_16MB=y

CONFIG_ESP_DEFAULT_CPU_FREQ_MHZ_360=y
CONFIG_SPIRAM=y
CONFIG_SPIRAM_SPEED_200M=y

# Type-C CH343 UART
CONFIG_ESP_CONSOLE_UART_DEFAULT=y
CONFIG_ESP_CONSOLE_UART_BAUDRATE=115200
```
